## Documentation/devicetree/bindings/display/panel/samsung,amb655x.yaml
```yaml
# SPDX-License-Identifier: (GPL-2.0-only OR BSD-2-Clause)
%YAML 1.2
---
$id: http://devicetree.org/schemas/display/panel/samsung,amb655x.yaml#
$schema: http://devicetree.org/meta-schemas/core.yaml#

title: Samsung AMB655X 1080x2400 120hz AMOLED panel

maintainers:
  - Caleb Connolly <caleb@postmarketos.org>

allOf:
  - $ref: panel-common.yaml#

properties:
  compatible:
    const: samsung,amb655x

  reg:
    maxItems: 1

  reset-gpios:
    description: reset gpio, must be GPIO_ACTIVE_LOW

  vddio-supply: true
  vdd-supply: true
  avdd-supply: true
  enable-gpios: true
  port: true

required:
  - compatible
  - reg
  - vdd-supply
  - avdd-supply
  - vddio-supply

additionalProperties: false

examples:
  - |
    #include <dt-bindings/gpio/gpio.h>
    panel@0 {
      reg = <0>;
      compatible = "samsung,amb655x";
      vddio-supply = <&vreg_l14a_1p8>;
      vdd-supply = <&vreg_l11c_3p3>;
      avdd-supply = <&panel_avdd_5p5>;
      reset-gpios = <&tlmm 75 GPIO_ACTIVE_LOW>;

      pinctrl-0 = <&panel_reset_pins &panel_vsync_pins &panel_vout_pins>;
      pinctrl-names = "default";

      status = "okay";

      port {
        panel_in_0: endpoint {
          remote-endpoint = <&mdss_dsi0_out>;
        };
      };
    };

...
```
